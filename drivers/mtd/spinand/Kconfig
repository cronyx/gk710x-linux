## drivers/mtd/spinand/Kconfig
```kconfig
#
# linux/drivers/mtd/spinand/Kconfig
#

menuconfig MTD_SPINAND
	tristate "SPINAND Device Support"
	depends on MTD
	help
	  This enables support for accessing SPI NAND flash device.

if MTD_SPINAND

config MTD_SPINAND_GOKE
	tristate "SPINAND on goke ipc support"
	depends on GK_SFLASH
	help
		Support for a SPINAND flash device connected to GK7101 EVB.

if MTD_SPINAND_GOKE
          
choice NAND_SFLASH_WR_MODE
	default NAND_SFLASH_4X_R_4X_W_MODE 
	prompt 'NAND SFLASH read write mode'
	help
	  NAND SFLASH read write mode.
	  
config NAND_SFLASH_1X_R_1X_W_MODE
	bool 'USE 1X mode read and 1X mode write'
	help
	  Enable USE 1X mode read write.

config NAND_SFLASH_4X_R_1X_W_MODE
	bool 'USE 4X mode read and 1X mode write'
	help
	  Enable USE 4X mode read and 1X mode write.

config NAND_SFLASH_4X_R_4X_W_MODE
	bool 'USE 4X mode read and 4X mode write'
	help
	  Enable USE 4X mode read and 4X mode write.
endchoice	  
          
config MTD_SPINAND_INTERECC
	bool "Use internal ECC"
	help
	  Internal ECC

config SELF_START_BLOCK
	bool "Save BBT to the special block"
	help
		save BBT to the special block by user
		
config DEBUG_W
	bool "Open debug mode to write"
	help
	  Debug to write spinand

config DEBUG_R
	bool "Open debug mode to read"
	help
	  Debug to read spinand
	  
endif

endif
```
